#include "Screen.h"

#define DEBUG

//Camera.cppへ！！！


int back_lists[4] = {0};


static const unsigned char PROGMEM image______Astray____bits[] = {0x00,0x00,0x00,0x00,0x00,0x00,0x00,0x00,0x00,0x00,0x00,0x00,0x00,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0xdf,0xff};
static const unsigned char PROGMEM image_Mono_harappa_bits[] = {0x00,0x00,0x00,0x00,0x00,0x00,0x00,0x00,0x00,0x00,0x00,0x00,0x00,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0x00,0x00};


//kicker.cppへ
bool KickerOnOff = 1;

//controller.cppへ
bool ContollerConnected = 1;


//Motor.cpp
int MotorSpeed = 80;

//Timer.h ?
float Timer = 999999;


long LastTouched = millis();
int LeftRight = 0;
int TrySetup = 0; // 型（int）を忘れずに

int Menu_y = 0;

int HowManyLine = 16;
int Line_en_offset = 20;

bool bectol = 1;
int Sita = 0;
float radian = Sita * PI / 180;

int senga_Y2 = sin(radian);
int senga_X2 = cos(radian);


int Line_r = 30;
int LineSize = 6;
bool Line[16] = {0};
//Screen_Gyro deg_data;


Screen_Gyro BNOdeg;
Screen_Gyro MIXdeg;
Screen_Gyro LSMdeg;


UltraSonic MyUSonic;

Adafruit_SSD1306 display(SCREEN_WIDTH, SCREEN_HEIGHT, &Wire1, -1);
Status now = Status::Menu;

const char *menus[]=
{
    "Mode",
    "Sensor",
    "Camera",
    "Speed",
    "Kicker",
    //"Timer",
    "Image",
    "      v"
};


const char *Sensor_menus[]=
{
    "Gyro",
    "IR",
    "Line",
    "Kicker",
    "UltraSonic",
    "   v"
};


const int number_of_menus = 7;
const int number_of_Sensors = 6;


class triangle
{
public:
    double main;
    
    double cosm(){
        return cos(main);
    }
    double sinm(){
        return sin(main);
    }
};


void Input_Back_List()
{
    if (int(now) != back_lists[0])
    {
        for (int i = 2; i >= 0; i--)
        {
            back_lists[i+1] = back_lists[i];
        }
        back_lists[0] = int(now);
    }
}

void Back()
{
    if ( digitalRead(BACK_BUTTON) == LOW && (millis() - LastTouched) > 300 )
    {
        LastTouched = millis();
        if ( back_lists[0] == int(Status::Controller) || back_lists[0] == int(Status::Menu) )
        {
            switch ( now )
            {
                case Status::Controller:
                    LeftRight = int(Menu_layout::Sensor);
                    break;

                case Status::Speed:
                    LeftRight = int(Menu_layout::Speed);
                    break;

                case Status::Kicker:
                    LeftRight = int(Menu_layout::Kicker);
                    break;

                case Status::Image:
                    LeftRight = int(Menu_layout::Image);
                    break;

                case Status::Gyro:
                    LeftRight = int(Sensor_layout::Gyro);
                    break;

                case Status::IR:
                    LeftRight = int(Sensor_layout::IR);
                    break;

                case Status::Line:
                    LeftRight = int(Sensor_layout::Line);
                    break;

                case Status::UltraSonic:
                    LeftRight = int(Sensor_layout::UltraSonic);
                    break;
            }
        }
        if (int(now) != back_lists[0])
        {
            now = Status(back_lists[0]);
            for (int i = 0; i < 3; i++)
            {
                back_lists[i] = back_lists[i+1];
            }
        }
        //return true;
    }
    else
    {
        //return false;
    }
}

bool Enter(){
    if ( digitalRead(ENTER_BUTTON) == LOW && (millis() - LastTouched) > 300 )
    {
        LastTouched = millis();
        Input_Back_List();
        return true;
    }
    else{
        return false;
    }
    
}

bool UpKey(){
    if ( digitalRead(UP_BUTTTON) == LOW && (millis() - LastTouched) > 300 )
    {
        LastTouched = millis();
        return true;
    }
    else
    {
        return false;
    }
    
}

bool DownKey(){
    if ( digitalRead(DOWN_BUTTON) == LOW && (millis() - LastTouched) > 300 )
    {
        LastTouched = millis();
        return true;
    }
    else{
        return false;
    }
}

/* float deg_radian(int deg){
    float radian = deg * PI /180;
    return radian;
} */

int senter_square(int wide){
    int indent = (SCREEN_WIDTH - wide)/2;
    return indent;
}

void writeCircle(int x, int y, int r){
    display.drawCircle(SCREEN_WIDTH/2 + x, SCREEN_HEIGHT/2 + y, r, WHITE);
}

void writefillCircle(int x, int y, int r){
    display.fillCircle(SCREEN_WIDTH/2 + x, SCREEN_HEIGHT/2 + y, r, WHITE);
}

void Screen_setup()
{
    //Serial.begin(115200);
    pinMode(DOWN_BUTTON, INPUT_PULLUP);
    pinMode(UP_BUTTTON, INPUT_PULLUP);
    pinMode(ENTER_BUTTON, INPUT_PULLUP);
    pinMode(back, INPUT_PULLUP);
    //pinMode()
    

    TrySetup = 0;
    
    while (!display.begin(SSD1306_SWITCHCAPVCC, 0x3C) && TrySetup < 3) 
    {
        Serial.println("Connecting...");
        delay(500);
        TrySetup++;
    }

    display.clearDisplay();
    display.setTextSize(1);
    display.setTextColor(SSD1306_WHITE);
    display.setCursor(0, 0);
    display.println("Hello, world!");
    display.display();
}

int yakusu(int value, int shuki){
    while (value < 0)
    {
        value += shuki;
    }
    while (value >= shuki)
    {
        value -= shuki;
    }
    
    return value;
}


int dosu(int value){
    while (value > 360)
    {
        value -= 360;
    }
    while (value < 0)
    {
        value += 360;
    }
    return value;
}

void ClearScreen()
{
    display.drawRect(0, 0, SCREEN_WIDTH, SCREEN_HEIGHT, BLACK);
    //display.clearDisplay();
}

void Screen_Update()
{
    BNOdeg.degf = yaw_BNO;
    MIXdeg.degf = deg_data;
    LSMdeg.degf = theta;

    for (int i = 0; i < MyUSonic.amount; i++)
    {
        MyUSonic.value[i] ++;
    }
/*
     if (!display.begin(SSD1306_SWITCHCAPVCC, 0x3C) && TrySetup == 3){ //TrySetup==3つまり、失敗し続けた場合のみ実行。
        display.println("Try retrying.");
        } 
*/
    display.clearDisplay();
/*     if (sennga_X2 == 20 ){
        sennga_X2 --;
        bectol = 0;
    }
    else if ( sennga_X2 == -20){
        sennga_X2 ++;
        bectol = 1;
    }
    else if (bectol == 0)
    {
        sennga_X2--;
    }
    else{
        sennga_X2++;
    } */

    //!!!!!!!!!!!!!!!!!!!!!!!!!!!!!!!!!!!!!!!!!!!!!!!!!!!!!!!!!!!!!!!!!!!!!!!!!!!!!!!!!謎Line線
    //display.drawLine(10, 13, SCREEN_WIDTH/3, 13, WHITE);
    Serial.print("button:");
    Serial.print(digitalRead(DOWN_BUTTON));   //下
    Serial.print(", ");
    Serial.print(digitalRead(ENTER_BUTTON));   //真ん中
    Serial.print(", ");
    Serial.println(digitalRead(UP_BUTTTON)); //上

/*
    if ( digitalRead(UP_BUTTTON) == HIGH && (millis() - LastTouched) > 300 && LeftRight > 0 )
    {
        LeftRight --;
        LastTouched = millis();
    }
    else if (digitalRead(DOWN_BUTTON) == HIGH && (millis() - LastTouched) > 300){
        LeftRight ++;
        LastTouched = millis();
    }
*/

        Sita ++;
        Sita = dosu(Sita);

        radian = deg_radian(Sita);
        senga_Y2 = cos(radian) * 15;
        senga_X2 = sin(radian) * 15;

    switch (now)
    {
    case Status::Menu:
        display.setCursor(0, 0);
        display.setTextSize(2);
        display.setFont(NULL);
        display.println("Menu");
        //Serial.println(*menus[1]);
/* メニューを表示する（旧）
        //display.println(" ");
        //display.println(" ");
        display.println("   Gyro");
        display.println(" ");
        display.println("   Line");
        display.println(" ");
        display.println("   Kicker");
        display.println(" ");
        display.println("   Controller");
        display.println(" ");
        display.println("   Speed");
        display.println(" ");
        display.println("   UltraSonic");
        display.println(" ");
        display.println("   Timer");
        display.println(" ");
        display.println("        v"); */
        if ( UpKey() == true )
        {
            LeftRight --;
            LastTouched = millis();
        }
        else if ( DownKey() == true ){
            LeftRight ++;
            LastTouched = millis();
        }

        LeftRight = yakusu(LeftRight, (number_of_menus - 1) );
        display.setCursor(0, Menu_y);
        //display.setTextSize(2);
        display.setTextSize(1);
        for (int i = 0; i < number_of_menus; i++)
        {
            //u8g2.setCursor(0, Menu_y + 0 + u8g2.getMaxCharHeight() * (1 + 2 * (i+3)) );
            //u8g2.print(menues[i]);
            if (i == LeftRight)
            {
                display.setCursor(8, Menu_y + 0 + FONT_HEIGHT * ( 2 * (i)));
                display.print(menus[i]);
            }
            else
            {
                display.setCursor(15, Menu_y + 0 + FONT_HEIGHT * ( 2 * (i)));
                display.print(menus[i]);
            }

            //u8g2.drawStr(0, Menu_y + 0 + FONT_HEIGHT * (1 + 2 * (i+3)), menues[i]);
        }
        //u8g2.setDrawColor(BLACK);
        //u8g2.drawBox(0, 0, SCREEN_WIDTH, 18);
/*         if (LeftRight < 3){
            Menu_y = -(LeftRight - 1) * 15;
        }
        else{
            Menu_y = -(LeftRight - 0.9) * 15 - LeftRight + 1;
        } */

        Menu_y = -8 * (LeftRight * 2 - 5);
        
        display.drawRect(senter_square(SCREEN_WIDTH - 10), 37 ,(SCREEN_WIDTH / 1.7), 13, WHITE);

        switch ( abs(LeftRight) % (number_of_menus - 1) )
        {
            case int(Menu_layout::Mode):
                if ( Enter() == true )
                {
                    LastTouched = millis();
                    LeftRight = 0;
                    now = Status::Mode;
                }
                break;

            case int(Menu_layout::Sensor):
                if (Enter() == true)
                {
                    LastTouched = millis();
                    now = Status::Controller;
                    LeftRight = 0;
                }
                break;

            case int(Menu_layout::Camera):
                if ( Enter() == true )
                {
                    LastTouched = millis();
                    now = Status::Camera;
                    LeftRight = 0;
                }
                break;

            case int(Menu_layout::Speed):
                if ( Enter() == true )
                {
                    LastTouched = millis();
                    now = Status::Speed;
                    LeftRight = 0;
                }
                break;

            case int(Menu_layout::Kicker):
                if ( Enter() == true )
                {
                    LastTouched = millis();
                    now = Status::Kicker;
                    LeftRight = 0;
                }
                break;



            case int(Menu_layout::Image):
                if ( Enter() == true )
                {
                    LastTouched = millis();
                    now = Status::Image;
                    LeftRight = 0;
                }
                break;
        }
/* //abs(LeftRight)の条件分岐（旧）
        if (abs(LeftRight) % 7 == 0){
            //display.drawRect(senter_square(SCREEN_WIDTH - 10), 22 ,(SCREEN_WIDTH - 10), 13, WHITE);
            if ( Enter() == true )
            {
                LastTouched = millis();

                now = Status::Gyro;
                LeftRight = 0;
            }
        }
        else if (abs(LeftRight) % 7 == 1)
        {
            //display.drawRect(senter_square(SCREEN_WIDTH - 10), 37 ,(SCREEN_WIDTH - 10), 13, WHITE);
            if ( Enter() == true )
            {
                LastTouched = millis();

                now = Status::Line;
                LeftRight = 0;
            }
        }
        else if (abs(LeftRight) % 7 == 2){
            //display.drawRect(senter_square(SCREEN_WIDTH - 10), 52 ,(SCREEN_WIDTH - 10), 13, WHITE);
            if ( Enter() == true )
            {
                LastTouched = millis();

                now = Status::Kicker;
                LeftRight = 0;
            }
        }
        else if (abs(LeftRight) % 7 == 3){
            //display.drawRect(senter_square(SCREEN_WIDTH - 10), 52 ,(SCREEN_WIDTH - 10), 13, WHITE);
            if ( Enter() == true )
            {
                LastTouched = millis();

                now = Status::Controller;
                LeftRight = 0;
            }
        }
        else if (abs(LeftRight) % 7 == 4){
            //display.drawRect(senter_square(SCREEN_WIDTH - 10), 52 ,(SCREEN_WIDTH - 10), 13, WHITE);
            if ( Enter() == true )
            {
                LastTouched = millis();

                now = Status::Speed;
                LeftRight = 0;
            }
        }
        else if (abs(LeftRight) % 7 == 5){
            if ( Enter() == true )
            {
                LastTouched = millis();

                now = Status::UltraSonic;
                LeftRight = 0;
            }
        }
        else if (abs(LeftRight) % 7 == 6){
            if ( Enter() == true )
            {
                LastTouched = millis();

                now = Status::Timer;
                LeftRight = 0;
            }
        } */

        display.setTextSize(1);
        display.setTextColor(SSD1306_WHITE);
        display.setCursor(SCREEN_WIDTH * 2 /3 + 15, SCREEN_HEIGHT - 15);
        //display.print("deg=");
        display.print(deg_data);
        display.drawCircle(SCREEN_WIDTH - 10, SCREEN_HEIGHT -15, 1, WHITE);

        display.fillRect(0, 0, SCREEN_WIDTH, 18 , BLACK);
        display.setCursor(SCREEN_WIDTH, 0);
        if ( SettingGoal == true )
        {
            display.println("            Yellow(1)");
        }
        else
        {
            display.println("              Blue(0)");
        }
        if ( Delection_Mode == true )
        {
            display.print("            CAMERA(1)");
        }
        else
        {
            display.print("              GYRO(0)");
        }
        //display.setCursor(0, 0);
        //display.setTextSize(2);
        //display.println("Menu");

        display.setTextSize(1);
        display.setFont(&FreeSerifBold9pt7b);
        display.setCursor(SCREEN_WIDTH, -10);
        display.print("Menu");
        display.setFont(NULL);
        //display.drawCircle(106, 41, 21, 1);
        display.drawCircle(109, 45, 17, 1);
        display.drawLine(109, 45, ((MIXdeg.sinGf() * 17)  + 109), (MIXdeg.cosGf() * 17)  + 45, WHITE);
        //display.drawLine(SCREEN_WIDTH/2 - 35, SCREEN_HEIGHT/2 , (SCREEN_WIDTH/2 + senga_X2 - 35), (SCREEN_HEIGHT/2 - senga_Y2), WHITE);
        //display.drawLine(10, 13, SCREEN_WIDTH/3, 13, WHITE);

        Serial.print("LeftRight");
        Serial.println(LeftRight);
        break;


    case Status::Gyro:
        Serial.print(senga_X2);
        Serial.print(", ");
        Serial.println(senga_Y2);
        
        //writeCircle(20, 0, 30);
        //display.drawLine(SCREEN_WIDTH/2 + 20, SCREEN_HEIGHT/2 , (SCREEN_WIDTH/2 + senga_X2 + 20), (SCREEN_HEIGHT/2 - senga_Y2), WHITE);

        //test
        writeCircle(0, 0, 15);
        writeCircle(35, 0, 15);
        writeCircle(-35, 0, 15);

        display.drawLine(SCREEN_WIDTH/2, SCREEN_HEIGHT/2 , (SCREEN_WIDTH/2 + MIXdeg.sinGf()*15 + 0), (SCREEN_HEIGHT/2 - MIXdeg.cosGf()*15), WHITE);
        display.drawLine(SCREEN_WIDTH/2 + 35, SCREEN_HEIGHT/2 , (SCREEN_WIDTH/2 + LSMdeg.sinGf()*15 + 35), (SCREEN_HEIGHT/2 - LSMdeg.cosGf()*15), WHITE);
        display.drawLine(SCREEN_WIDTH/2 - 35, SCREEN_HEIGHT/2 , (SCREEN_WIDTH/2 + BNOdeg.sinGf()*15 - 35), (SCREEN_HEIGHT/2 - BNOdeg.cosGf()*15), WHITE);
        display.setTextSize(1);
        display.setCursor(20, 35);
        display.println("BNO");
        display.setTextSize(1);
        display.setCursor(56, 35);
        display.println("MIX");

        display.setTextSize(1);
        display.setCursor(91, 35);
        display.println("LSM");
        //Menu名
/* 
        display.setTextSize(2);
        display.setCursor(0, 0);
        display.println("Gyro"); */
        display.setTextSize(1);
        display.setFont(&FreeSerifBold9pt7b);
        display.setCursor(SCREEN_WIDTH, -10);
        display.print("Gyro");
        display.setFont(NULL);

        display.setTextSize(1);
        display.setTextColor(SSD1306_WHITE);
        display.setCursor(0, SCREEN_HEIGHT - 10);
        display.print("BNO=");
        display.print(yaw_BNO);
        display.print(", MIX=");
        display.print(deg_data);
        display.print("LSM=");
        display.println(theta);

        if ( Enter() == true )
        {
            LastTouched = millis();
            now = Status::Menu;
        }
        break;


    case Status::IR:
        display.setTextSize(1);
        display.setFont(&FreeSerifBold9pt7b);
        display.setCursor(SCREEN_WIDTH, -10);
        display.print("IR");
        display.setFont(NULL);
        display.setCursor(0, 20);
        display.print("IRdeg=");

        if ( IRv.detected == true )
        {
            display.println(IRv.deg);
        }
        else
        {
            display.println("NoDetected");
        } 

        display.print("IRdis=");
        display.println(IRv.dis);
        
        //display.println(IRv.deg);

        //円を描く
        writeCircle(Line_en_offset, 0, Line_r);
        writeCircle(Line_en_offset, 0, 10);

        //Line描画
        //display.drawRect(senter_square(10), SCREEN_HEIGHT/2 - 10/2 ,10, 10, WHITE);
        //display.drawRect(senter_square(10) + Line_r, SCREEN_HEIGHT/2 - 10/2 ,10, 10, WHITE);

        if ( UpKey() == true )
        {
            LeftRight --;
            LastTouched = millis();
        }
        else if ( DownKey() == true ){
            LeftRight ++;
            LastTouched = millis();
        }

        
        if (abs(LeftRight) % 4 == 0)
        {
            for (int i = 0; i < 3; i++)
            {
                Line[i] = 1;
            }
            
        }
        else if (abs(LeftRight) % 3 == 0){
            for (int i = 3; i < 6; i++)
            {
                Line[i] = 1;
            }
            
        }
        else if (abs(LeftRight) % 2 == 0){
            for (int i = 6; i < 8; i++)
            {
                Line[i] = 1;
            }
            
        }
        else{
            for (int i = 0; i < 8; i++)
            {
                Line[i] = 0;
            }
        }

        for (int i = 0; i < HowManyLine ; i++){
            double OneDeg = 360 / HowManyLine;
            OneDeg = OneDeg * PI / 180;
            triangle Linedeg;
            Linedeg.main = OneDeg * i; 
            
            if (Line[i] == LOW){
                //display.drawRect(int(senter_square(LineSize) + (Linedeg.cosm() * (Line_r * 0.8)) + Line_en_offset), int (SCREEN_HEIGHT/2 - LineSize/2 - Linedeg.sinm() * (Line_r * 0.8)) ,LineSize, LineSize, WHITE);
                writeCircle(Line_en_offset + (Linedeg.cosm() * (Line_r * 0.8)), Linedeg.sinm() * (Line_r * 0.8), 3);
            }
            else{
                //display.fillRect(int(senter_square(LineSize) + Linedeg.cosm() * (Line_r * 0.8) + Line_en_offset), int (SCREEN_HEIGHT/2 - LineSize/2 - Linedeg.sinm() * (Line_r * 0.8)) ,LineSize, LineSize, WHITE);
                writefillCircle(Line_en_offset+ (Linedeg.cosm() * (Line_r * 0.8)), Linedeg.sinm() * (Line_r * 0.8), 3);
            }
        }

        if ( Enter() == true)
        {
            LastTouched = millis();
            LeftRight = 1;
            now = Status::Menu;
        }
        break;


    case Status::Line:
        //Menu名
/* 
        display.setTextSize(2);
        display.setCursor(0, 0);
        display.println("Line"); */
        display.setTextSize(1);
        display.setFont(&FreeSerifBold9pt7b);
        display.setCursor(SCREEN_WIDTH, -10);
        display.print("Line");
        display.setFont(NULL);
        display.setCursor(0, 20);
        display.println("deg=");
        if (LineNeed == true)
        {
            display.println(DegRangeChange(radian_deg(Angel.Linedegr) , -180));
            display.println(LineMoveDegd);
        }
        else
        {
            display.println("NotDetected");
        }
        

        //円を描く
        //writeCircle(Line_en_offset, 0, Line_r);
        //writeCircle(Line_en_offset, 0, 10);
        //Line描画
        //display.drawRect(senter_square(10), SCREEN_HEIGHT/2 - 10/2 ,10, 10, WHITE);
        //display.drawRect(senter_square(10) + Line_r, SCREEN_HEIGHT/2 - 10/2 ,10, 10, WHITE);

        if ( UpKey() == true )
        {
            LeftRight --;
            LastTouched = millis();
        }
        else if ( DownKey() == true ){
            LeftRight ++;
            LastTouched = millis();
        }
        

        for (int i = 0; i < HowManyLine ; i++)
        {
            //float OneDeg = deg_radian(Angel.degs[i] + 90);
            triangle Linedeg;
            Linedeg.main = deg_radian(Angel.degs[i] - 90);
            Line[i] = Angel.Detect[i];
            
            if (Line[i] == LOW){
                //display.drawRect(int(senter_square(LineSize) + (Linedeg.cosm() * (Line_r * 0.8)) + Line_en_offset), int (SCREEN_HEIGHT/2 - LineSize/2 - Linedeg.sinm() * (Line_r * 0.8)) ,LineSize, LineSize, WHITE);
                writeCircle(Line_en_offset + (Linedeg.cosm() * (Line_r * 0.8)), Linedeg.sinm() * (Line_r * 0.8), 3);
            }
            else{
                //display.fillRect(int(senter_square(LineSize) + Linedeg.cosm() * (Line_r * 0.8) + Line_en_offset), int (SCREEN_HEIGHT/2 - LineSize/2 - Linedeg.sinm() * (Line_r * 0.8)) ,LineSize, LineSize, WHITE);
                writefillCircle(Line_en_offset+ (Linedeg.cosm() * (Line_r * 0.8)), Linedeg.sinm() * (Line_r * 0.8), 3);
            }
        }

        if ( Enter() == true )
        {
            LastTouched = millis();
            LeftRight = 1;
            now = Status::Menu;
        }
        break;


    case Status::Kicker:
/* 
        display.setTextSize(2);
        display.setCursor(0, 0);
        display.println("Kicher"); */
        
        display.setTextSize(1);
        display.setFont(&FreeSerifBold9pt7b);
        display.setCursor(SCREEN_WIDTH, -10);
        display.print("Kicker");
        display.setFont(NULL);
        display.setCursor(0, 20);

        if (Enter() == true)
        {
            LeftRight = int(Menu_layout::Kicker);
            now = Status::Menu;
        }

        display.setTextSize(1);
        display.println(" ");
        display.println("   ON!!!!(push upkey)");
        display.println(" ");
        
        if (DownKey() == true)
        {
            if (KickerOnOff == true)
            {
                KickerOnOff = false;
                display.println("   Kicker <OFF>");
            }
            else
            {
                KickerOnOff = true;
                display.println("   Kicker <ON>");
            }
            
        }
        else
        {
            if (KickerOnOff == true)
            {
                display.println("   Kicker <ON>");
            }
            else
            {
                display.println("   Kicker <OFF>");
            }
            
        }

        if (UpKey() == true)
        {
            now = Status::ONKicker;
        }
        
        display.println("   (Change: Down Key)");
        break;


    case Status::ONKicker:
        display.clearDisplay();
        display.drawRect(senter_square(SCREEN_WIDTH - 10), (SCREEN_HEIGHT - 40)/2 ,(SCREEN_WIDTH - 10), 40, WHITE);
        display.setTextSize(1);

        display.setCursor(15, 15);
        display.println("ON!!!!");
        display.setCursor(15, 30);
        display.println("Please wait");
        Kicker_end();
        delay(100);
        Kick();
        //Kick();
        for (int i = senter_square(SCREEN_WIDTH - 10); i < SCREEN_WIDTH - senter_square(SCREEN_WIDTH - 10) ; i++)
        {
            display.drawLine(senter_square(SCREEN_WIDTH - 10), 50, i, 50, WHITE);
            display.display();
            delay(1);
        }
        Kicker_end();
        LeftRight = int(Menu_layout::Kicker);
        now = Status::Menu;
        
        break;


    case Status::Controller:
/* 
        display.setTextSize(2);
        display.setCursor(0, 0);
        display.println("Controller"); */
        display.setTextSize(1);
        display.setFont(&FreeSerifBold9pt7b);
        display.setCursor(SCREEN_WIDTH, -10);
        display.print("Sensor");
        display.setFont(NULL);
        display.setCursor(0, 20);
        display.drawRect(52, 37 ,SCREEN_WIDTH-55 -5, 13, WHITE);

        switch ( abs(LeftRight) % (number_of_Sensors) )
        {
            case 0:
                if ( Enter() == true )
                {
                    LastTouched = millis();
                    now = Status::Gyro;
                    LeftRight = 0;
                }
                break;

            case 1:
                if ( Enter() == true )
                {
                    LastTouched = millis();
                    now = Status::IR;
                    LeftRight = 0;
                }
                break;

            case 2:
                if ( Enter() == true )
                {
                    LastTouched = millis();
                    now = Status::Line;
                    LeftRight = 0;
                }
                break;

            case 3:
                if ( Enter() == true )
                {
                    LastTouched = millis();
                    now = Status::Kicker;
                    LeftRight = 0;
                }
                break;

            case 4:
                if ( Enter() == true )
                {
                    LastTouched = millis();
                    now = Status::UltraSonic;
                    LeftRight = 0;
                }
                break;

            case 5:
                if ( Enter() == true )
                {
                    LastTouched = millis();
                    now = Status::Menu;
                    LeftRight = int(Menu_layout::Sensor);
                }
                break;
        }

        if ( UpKey() == true )
        {
            LeftRight --;
            LastTouched = millis();
        }
        else if ( DownKey() == true )
        {
            LeftRight ++;
            LastTouched = millis();
        }

        display.setCursor(8, 40);
        display.setTextColor(WHITE);
        display.print("Sensor>");
        LeftRight = yakusu(LeftRight, (number_of_Sensors) );
        display.setTextColor(WHITE);
        for (int i = 0; i < number_of_Sensors; i++)
        {
            //u8g2.setCursor(0, Menu_y + 0 + u8g2.getMaxCharHeight() * (1 + 2 * (i+3)) );
            //u8g2.print(menues[i]);
            //display.setCursor(53, Menu_y + 0 + FONT_HEIGHT * ( 2 * (i)));
            //display.print(Sensor_menus[i]);
            //u8g2.drawStr(0, Menu_y + 0 + FONT_HEIGHT * (1 + 2 * (i+3)), menues[i]);
            if (i == LeftRight)
            {
                display.setCursor(55, Menu_y + 0 + FONT_HEIGHT * ( 2 * (i)));
                display.print(Sensor_menus[i]);
            }
            else
            {
                display.setCursor(62, Menu_y + 0 + FONT_HEIGHT * ( 2 * (i)));
                display.print(Sensor_menus[i]);
            }
        }
        Menu_y = -8 * (LeftRight * 2 - 5);
/*         if (ContollerConnected == true)
        {
            writeCircle(35, 15, 10);     //WriteLeftCircle
            writeCircle(-35, 15, 10);    //WriteRightCircle
            //スティックの座標に合わせて、変化させる。-128~128を-15~15に変換する。0.1171875をかける。
            writefillCircle(35, 15, 2);
            writefillCircle(-35, 15, 2);
        }
        else{
            display.setTextSize(1);
            display.println("unpairing");
        } */
        
/*         if (Enter() == true)
        {
            LeftRight = 3;
            now = Status::Menu;
        } */
        break;

    case Status::Speed:
        display.setTextSize(1);
        display.setFont(&FreeSerifBold9pt7b);
        display.setCursor(SCREEN_WIDTH, -10);
        display.print("Speed");
        display.setFont(NULL);
        display.setCursor(0, 20);

/*         display.setTextSize(2);
        display.setCursor(0, 0);
        display.println("Speed"); */
        display.setTextSize(1);
        display.print("Speed: ");
        display.print(MotorSpeed);
        display.println("%");
        display.drawLine(15, SCREEN_HEIGHT/2 , (SCREEN_WIDTH - 30) * MotorSpeed /100 + 15 , SCREEN_HEIGHT/2, WHITE);
        display.drawCircle(15, SCREEN_HEIGHT/2, 1, WHITE);
        display.drawCircle(SCREEN_WIDTH - 15, SCREEN_HEIGHT/2, 1, WHITE);
        display.drawRect(senter_square(SCREEN_WIDTH - 30), (SCREEN_HEIGHT-6)/2 ,(SCREEN_WIDTH - 30), 6, WHITE);
        display.fillRect(15, (SCREEN_HEIGHT-6)/2, (SCREEN_WIDTH - 30) * MotorSpeed /100 + 1, 6, WHITE);
        if (UpKey() == true && MotorSpeed < 100){
            MotorSpeed++;
        }
        else if (DownKey() == true && MotorSpeed > 0)
        {
            MotorSpeed--;
        }
        else if (digitalRead(UP_BUTTTON) == LOW && (millis() - LastTouched) > 75 && MotorSpeed < 100){
            MotorSpeed++;
        }
        else if (digitalRead(DOWN_BUTTON) == LOW && (millis() - LastTouched) > 75 && MotorSpeed > 0){
            MotorSpeed--;
        }
        

        if (Enter() == true)
        {
            LeftRight = int(Menu_layout::Speed);
            now = Status::Menu;
        }
        break;


    case Status::Runnning:

        display.setTextSize(2);
        display.setCursor(0, 0);
        display.println("Running");
        break;


    case Status::UltraSonic:
        display.setTextSize(1);
        display.setFont(&FreeSerifBold9pt7b);
        display.setCursor(SCREEN_WIDTH, -10);
        display.print("UltraSonic");
        display.setFont(NULL);
        display.setCursor(0, 20);

/* 
        display.setTextSize(2);
        display.setCursor(0, 0);
        display.println("UltraSonic"); */
        display.setTextSize(1);
        for (int i = 0; i < MyUSonic.amount; i++ ){
            display.print("UltraSonic");
            display.print(MyUSonic.pin[i]);
            display.print(": ");
            display.println(MyUSonic.value[i]);
        }

        if (Enter() == true){
            LeftRight = 5;
            now = Status::Menu;
        }
        break;


    case Status::TimeSelect:
        display.fillRect(senter_square(SCREEN_WIDTH - 10), (SCREEN_HEIGHT+10)/2 ,(SCREEN_WIDTH - 10), 24, BLACK);
        display.drawRect(senter_square(SCREEN_WIDTH - 10), (SCREEN_HEIGHT+10)/2 ,(SCREEN_WIDTH - 10), 24, WHITE);
        display.setCursor(15, (SCREEN_HEIGHT+10)/2 + 3);
        display.println("ON!!!!");
        display.setCursor(15, (SCREEN_HEIGHT+10)/2 +13);
        display.println("Please Select");

        display.setTextSize(2);
        display.setCursor(0, 0);
        display.println(" ");
        display.setTextSize(1);
        if (Timer != 999999)
        {
            display.println("   Timer <ON>");
            display.print("TimeLeft: ");
            display.print(int(Timer/60));
            if ( (Timer - (int(Timer/60)) * 60) <10)
            {
                display.print(":0");
            }else{
                display.print(":");
            }
            display.println(Timer - (int(Timer/60)) * 60);
        }
        else{
            display.println("   Timer <OFF>");
        }


    if (Timer != 999999){
        if (UpKey() == true ){
            Timer++;
        }
        else if (DownKey() == true )
        {
            Timer--;
        }
        else if (digitalRead(UP_BUTTTON) == LOW && (millis() - LastTouched) > 80 ){
            Timer++;
        }
        else if (digitalRead(DOWN_BUTTON) == LOW && (millis() - LastTouched) > 80 ){
            Timer--;
        }
    }

        if (Enter() == true){
            now = Status::Timer;
        }
        break;


    case Status::Image:
        if (DownKey() == true)
        {
            LeftRight--;
        }
        if (UpKey() == true)
        {
            LeftRight++;
        }
        LeftRight = yakusu(LeftRight, 2);
        switch (LeftRight % 2)
        {
        case 0:
            display.drawBitmap(-18, 0, image______Astray____bits, 160, 64, 1);
            break;
        
        case 1:
            display.drawBitmap(-18, 0, image_Mono_harappa_bits, 154, 64, 1);
            break;
        }
        if (Enter() == true){
            LeftRight = int(Menu_layout::Image);
            now = Status::Menu;
        }
        break;


    case Status::Camera:
        display.setTextSize(1);
        display.setFont(&FreeSerifBold9pt7b);
        display.setCursor(SCREEN_WIDTH, -10);
        display.print("Camera");
        display.setFont(NULL);
        display.setCursor(0, 20);
        display.print("Goal:");

        if ( UpKey() == true )
        {
            SettingGoal = 1;
        }

        if (DownKey() == true)
        {
            SettingGoal = 0;
        }

        if ( SettingGoal == true )
        {
            display.println("Yellow(1)");
        }
        else
        {
            display.println("Blue(0)");
        }
        
        display.print("Court_deg=");
        display.println(CameraV.court_deg);
        display.print("Yelllow_deg=");
        display.println(CameraV.yellow_deg);
        display.print("Yellow_dis=");
        display.println(CameraV.yellow_dis);
        display.print("Blue_deg=");
        display.println(CameraV.blue_deg);
        display.print("Blue_dis=");
        display.println(CameraV.blue_dis);
        

        if (Enter() == true)
        {
            LeftRight = int(Menu_layout::Camera);
            now = Status::Menu;
        }
        break;


    case Status::Mode:
        display.setTextSize(1);
        display.setFont(&FreeSerifBold9pt7b);
        display.setCursor(SCREEN_WIDTH, -10);
        display.print("Mode");
        display.setFont(NULL);
        display.setCursor(0, 20);

        display.setTextSize(1);
        
        if ( UpKey() == true )
        {
            LeftRight--;
        }

        if (DownKey() == true)
        {
            LeftRight++;
        }

        LeftRight = yakusu(LeftRight, 4);


        display.drawRect(8, 16 + ( 12 * LeftRight), SCREEN_WIDTH -16, FONT_HEIGHT + 3, WHITE);
        if (Enter() == true)
        {
            if (LeftRight == 0)
            {
                SettingGoal = (SettingGoal == 0) ?  1 : 0;
            }
            else if (LeftRight == 1)
            {
                Delection_Mode = (Delection_Mode == 0) ? 1 : 0;
            }
            else if (LeftRight == 2)
            {
                DEForATTA = (DEForATTA == 0) ? 1 : 0;
            }
            else if (LeftRight == 3)
            {
                now = Status::Menu;
                LeftRight = int(Menu_layout::Mode);
            }
        }


        display.setCursor(0, 18);
        display.print("  Delection:");
        if ( SettingGoal == true )
        {
            display.println("Yellow(1)");
        }
        else
        {
            display.println("Blue(0)");
        }
        

        display.setCursor(0, 18 + 12);
        display.print("  Goal:");
        if ( Delection_Mode == true )
        {
            display.println("CAMERA(1)");
        }
        else
        {
            display.println("GYRO(0)");
        }

        display.setCursor(0, 18 + 12 * 2);
        display.print("  SET:");
        if ( DEForATTA == true )
        {
            display.println("ATACKER(1)");
        }
        else
        {
            display.println("DEFENDER(0)");
        }

        display.setCursor(0, 18 + 12 * 3);
        display.print("     >");

        break;
    }

    //display.invertDisplay(true);
    display.display();
    Serial.print("Back_lists:");
    for (int i = 0; i < 4; i++)
    {
        Serial.print(back_lists[i]);
        Serial.print(",");
    }
    Serial.println(" ");

    Back();
    //delay(20);
}